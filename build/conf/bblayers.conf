## build/conf/bblayers.conf
```bitbake
# POKY_BBLAYERS_CONF_VERSION is increased each time build/conf/bblayers.conf
# changes incompatibly
POKY_BBLAYERS_CONF_VERSION = "2"

BBPATH = "${TOPDIR}"
BBFILES ?= ""

BBLAYERS ?= " \
  /data/francis/polarsys-os/poky/meta \
  /data/francis/polarsys-os/poky/meta-poky \
  /data/francis/polarsys-os/poky/meta-yocto-bsp \
  "
```

## build/conf/local.conf
```bitbake
MACHINE ?= "raspberrypi2"
DISTRO ?= "poky"
PACKAGE_CLASSES ?= "package_ipk"
EXTRA_IMAGE_FEATURES ?= "debug-tweaks"
USER_CLASSES ?= "buildstats image-mklibs"
PATCHRESOLVE = "noop"
BB_DISKMON_DIRS = "\
    STOPTASKS,${TMPDIR},1G,100K \
    STOPTASKS,${DL_DIR},1G,100K \
    STOPTASKS,${SSTATE_DIR},1G,100K \
    STOPTASKS,/tmp,100M,100K \
    ABORT,${TMPDIR},100M,1K \
    ABORT,${DL_DIR},100M,1K \
    ABORT,${SSTATE_DIR},100M,1K \
    ABORT,/tmp,10M,1K"
PACKAGECONFIG_append_pn-qemu-native = " sdl"
PACKAGECONFIG_append_pn-nativesdk-qemu = " sdl"

# uImage enables U-Boot, but does not build, possible solution:
# http://permalink.gmane.org/gmane.linux.embedded.yocto.general/30146
# KERNEL_IMAGETYPE = "uImage"

# required for ffmpeg
LICENSE_FLAGS_WHITELIST = "commercial Firmware-ralink-firmware"
CONF_VERSION = "1"
ENABLE_I2C = "1"
ENABLE_UART = "1"

PREFERRED_PROVIDER_virtual/kernel ?= "linux-raspberrypi-rt"

# Isolate the cpu 3 for real-time tasks
# and do not run irqs on it to reduce jitter
CMDLINE_append = " isolcpus=3 irqaffinity=0,1,2 "

include local.inc
```

## meta-polarsys/conf/layer.conf
```bitbake
# We have a conf and classes directory, append to BBPATH
BBPATH .= ":${LAYERDIR}"

# We have a recipes directory containing .bb and .bbappend files, add to BBFILES
BBFILES += "${LAYERDIR}/recipes*/*/*.bb \
            ${LAYERDIR}/recipes*/*/*.bbappend"

BBFILE_COLLECTIONS += "polarsys"
BBFILE_PATTERN_polarsys := "^${LAYERDIR}/"
BBFILE_PRIORITY_polarsys = "9"

DISTRO_FEATURES_remove = " x11"
```
